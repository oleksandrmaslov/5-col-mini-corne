## boards/shields/corne/Kconfig.shield
```kconfig
# Copyright (c) 2020 Pete Johanson
# SPDX-License-Identifier: MIT

config SHIELD_CORNE_WIDGETS_LEFT
    def_bool $(shields_list_contains,corne_widgets_left)

config SHIELD_CORNE_WIDGETS_RIGHT
    def_bool $(shields_list_contains,corne_widgets_right)
```

## config/west.yml
```yaml
manifest:
  remotes:
    - name: zmkfirmware
      url-base: https://github.com/zmkfirmware
    - name: zzeneg 
      url-base: https://github.com/zzeneg
    - name: oleksandrmaslov
      url-base: https://github.com/oleksandrmaslov
    - name: badjeff
      url-base: https://github.com/badjeff
  projects:
    - name: zmk
      remote: zmkfirmware
      revision: main
      import: app/west.yml
    - name: zmk-split-peripheral-output-relay
      remote: oleksandrmaslov
      revision: codex/raw-hid-split-chunking
    - name: zmk-nice-view-hid 
      remote: oleksandrmaslov
      revision: codex/nice-view-hid-ui-rework
    - name: zmk-raw-hid 
      remote: oleksandrmaslov
      revision: codex/raw-hid-split-chunking
  self:
    path: config
```
